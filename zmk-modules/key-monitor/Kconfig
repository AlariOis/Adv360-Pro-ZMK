## zmk-modules/key-monitor/Kconfig
```kconfig
config ZMK_KEY_MONITOR
	bool "Stream key positions and layer state over a USB serial port"
	depends on USB_CDC_ACM && UART_INTERRUPT_DRIVEN && UART_LINE_CTRL
	help
	  TEST BUILDS ONLY. Every key press is sent to whoever opens the
	  serial port (the chosen zmk,key-monitor-uart), i.e. a keylogger for
	  local programs. Enable it with the key-monitor snippet.

	  On a split peripheral (the right half) it reports and injects only
	  that half's key positions (no L/I): injected presses reach the
	  central over the split link, with its real latency.

	  Protocol, one ASCII line per message:
	    device -> host  "H key-monitor <version> inject=<0|1> keys=<n> role=<central|peripheral>"
	                    "P <position> <1|0> <us>"  key pressed / released,
	                                           <us>: this half's uptime
	                    "L <layer mask hex> <highest layer>"
	                    "I <hex>"              HID indicators (LEDs), bit 1 = caps lock
	                    "B <role> <interval> <latency> <timeout> <tx phy> <rx phy>"
	                    per Bluetooth link (1.25 ms / 10 ms units), then "B end"
	    host -> device  "?"                    resend H and L
	                    "B"                    report the Bluetooth links
	                    "X"                    reboot this half
	                    "S"                    split-timing press->processing delays
	                                           (then reset): "S local n= mean= max= ..."
	                    "K <position> <1|0>"   inject a press / release
	                    "I"                    report the HID indicators (LED state)
	                    "M [<us>]"             raw matrix probe of this half, bypassing
	                                           ZMK (docs/keyfix.md); <us> (0-1000,
	                                           default 0) settle time per column:
	                    "M us=<us> out=<hex> idle=<hex> c0=<hex> ... c<n>=<hex> drv=<hex> rel=<hex> hd=<hex> pu=<hex>"
	                      out   columns ZMK was driving active when probed
	                      idle  rows high as found (idle ZMK drives all columns)
	                      c<i>  rows high with only column i driven (bit = row)
	                      drv   columns whose pad reads back active when driven
	                      rel   columns whose pad reads back active when released
	                      hd    the same as drv with the high drive (H0H1)
	                      pu    columns whose pad reads high as an input with
	                            only the pull-up (none: held low from outside)

config ZMK_KEY_MONITOR_INJECT
	bool "Accept injected key presses from the host"
	depends on ZMK_KEY_MONITOR
	help
	  TEST BUILDS ONLY. Lets any local program with access to the serial
	  port press keys, as if typed on the keyboard (also over Bluetooth).
```

## zmk-modules/smart-keys/Kconfig
```kconfig
config ZMK_MOD_MORPH_UNMASK_ON_NEXT_KEY
	bool "Stop mod-morph modifier masking when another key is pressed"
	depends on !ZMK_SPLIT || ZMK_SPLIT_ROLE_CENTRAL
	help
	  A mod-morph that hides the modifier that triggered it (e.g. Shift for
	  a shift-proof '=') keeps hiding it for as long as its key is held, for
	  every key. When typing fast the next key is often pressed before the
	  mod-morph key is released, and comes out without Shift ('>l' instead
	  of '>L'). With this option the mask is cleared as soon as another key
	  is pressed; the mod-morph's own key press was already sent by then.

config ZMK_BEHAVIOR_SMART_REPEAT
	bool
	default y
	depends on DT_HAS_ZMK_BEHAVIOR_SMART_REPEAT_ENABLED
	depends on !ZMK_SPLIT || ZMK_SPLIT_ROLE_CENTRAL

if ZMK_BEHAVIOR_SMART_REPEAT

config ZMK_SMART_REPEAT_MAX_KEYS
	int "Most keycodes one repeat replays (macros, unicode entry)"
	default 32

config ZMK_SMART_REPEAT_STEP_MS
	int "Delay between replayed key presses/releases of a multi-key recording"
	default 5

config ZMK_SMART_REPEAT_SPLIT_WAIT_MS
	int "How long a repeat key on the central half waits for the other half"
	default 25
	help
	  Split keyboards: the peripheral's key presses reach the central a
	  few ms to ~20 ms late (Bluetooth). A repeat key on the central half
	  waits this long before repeating, so a key pressed just before it on
	  the other half is the one repeated. The central's own key events in
	  the meantime are held back and replayed after it. 0 disables.

endif

config ZMK_BEHAVIOR_ONESHOT_LAYER
	bool
	default y
	depends on DT_HAS_ZMK_BEHAVIOR_ONESHOT_LAYER_ENABLED
	depends on !ZMK_SPLIT || ZMK_SPLIT_ROLE_CENTRAL

config ZMK_BEHAVIOR_SMART_CAPS_WORD
	bool
	default y
	depends on DT_HAS_ZMK_BEHAVIOR_SMART_CAPS_WORD_ENABLED
	depends on !ZMK_SPLIT || ZMK_SPLIT_ROLE_CENTRAL
```

## zmk-modules/smart-keys/dts/bindings/behaviors/zmk,behavior-oneshot-layer.yaml
```yaml
description: |
  One-shot layer: tap = layer on for the next non-modifier key, tap again =
  off, hold = momentary. Releasing it after starting Ctrl+Shift+U unicode
  entry while holding it sends Enter to finish the entry.

compatible: "zmk,behavior-oneshot-layer"

include: one_param.yaml

properties:
  release-after-ms:
    type: int
    default: 1000
```

## zmk-modules/smart-keys/dts/bindings/behaviors/zmk,behavior-smart-caps-word.yaml
```yaml
description: |
  Caps word (tap to toggle) that keeps going through this keymap's compose
  macros (ScrollLock + accent + letter, the letter is shifted) and lights the
  caps lock LED while on.

compatible: "zmk,behavior-smart-caps-word"

include: zero_param.yaml

properties:
  continue-list:
    type: array
    required: true
  mods:
    type: int
```

## zmk-modules/smart-keys/dts/bindings/behaviors/zmk,behavior-smart-repeat.yaml
```yaml
description: |
  Repeat key that replays everything the last key typed: whole macros,
  Ctrl+Shift+U unicode entry, with the exact modifiers. Skips Space.

compatible: "zmk,behavior-smart-repeat"

include: zero_param.yaml
```

## zmk-modules/smart-keys/dts/bindings/behaviors/zmk,behavior-sticky-shift.yaml
```yaml
description: |
  Sticky Shift: wraps a Shift binding (e.g. a Shift + layer macro).
  Held: the binding is held; pressing any other key meanwhile makes it a
  plain hold. Tapped alone: stays held until the next key that types
  something has been sent completely (or release-after-ms), tap again = off.
  With Ctrl, Alt or Super held when pressed: always a plain hold.

compatible: "zmk,behavior-sticky-shift"

include: zero_param.yaml

properties:
  bindings:
    type: phandle-array
    required: true
  release-after-ms:
    type: int
    default: 1000
```

## zmk-modules/split-radio/Kconfig
```kconfig
config ZMK_SPLIT_RADIO
	bool "Split link over the raw nRF52840 radio instead of Bluetooth"
	depends on ZMK_SPLIT && !BT && SOC_NRF52840
	help
	  Both halves talk over the radio in Nordic's proprietary 2 Mbit mode
	  on one channel, AES-CCM encrypted with a pre-shared key: sub-ms
	  latency instead of Bluetooth's 3-20 ms. Needs CONFIG_BT=n (the radio
	  can't be shared with Zephyr's Bluetooth controller), so the keyboard
	  works over USB only (left half plugged in). The left half keeps its
	  receiver on (~5 mA from USB); the right half runs on its battery,
	  sends key events at once and polls the left half every POLL_MS for
	  the LED state.

if ZMK_SPLIT_RADIO

config ZMK_SPLIT_RADIO_KEY
	string "Pre-shared AES-128 key, 32 hex digits (generated by the Makefile)"

config ZMK_SPLIT_RADIO_FREQUENCY
	int "Channel: 2400 + this MHz (default 2477: above Wi-Fi channel 11)"
	default 77
	range 0 100
	help
	  2477 MHz is above Wi-Fi channel 11 (2452-2472 MHz) and clear of
	  Bluetooth advertising on 2480. The old 2450 sat between the side
	  bands of channels 6 and 11, the most used Wi-Fi channels: next to an
	  access point on channel 11 it lost 69 % of its frames (2477: 3 %,
	  docs/split-latency-research.md). Where Wi-Fi uses channel 12 or 13,
	  pick another one (make EXTRA_CMAKE=-DCONFIG_ZMK_SPLIT_RADIO_FREQUENCY=N,
	  both halves).

config ZMK_SPLIT_RADIO_TX_POWER
	int "TX power register value (0 = 0 dBm, 8 = +8 dBm, 0xFC = -4 dBm)"
	default 0

config ZMK_SPLIT_RADIO_ACK_DELAY_US
	int "Left half: ack this long after a frame (the right half must be listening)"
	default 200

config ZMK_SPLIT_RADIO_ACK_TIMEOUT_US
	int "How long the right half waits for an ack"
	default 800

config ZMK_SPLIT_RADIO_RESYNC_MS
	int "Right half: handshake again after this long without an ack"
	default 1000
	help
	  The left half may have restarted without its NEED_HELLO answer
	  getting through. Shorter outages (interference) only cost resends:
	  quick ones first, after 20 every 20-30 ms, after 5 s without the left
	  half slower and slower up to 1 s.

config ZMK_SPLIT_RADIO_POLL_MS
	int "Right half: poll the left half this often without key events"
	default 100
	help
	  Brings the LED state (layer colors, caps lock, ...) to the right half
	  and shows that the link is up. Each poll costs ~1 ms of radio and
	  crystal time: ~50 uA at 100 ms.

config ZMK_SPLIT_RADIO_HF_HOLD_MS
	int "Right half: keep the crystal oscillator running this long after sending"
	default 1000
	help
	  Starting it takes ~0.4 ms (added to the first key after a pause);
	  running costs ~0.25 mA.

config ZMK_SPLIT_RADIO_STALE_MS
	int "Right half: drop key presses older than this when the link comes back"
	default 500

endif
```

## zmk-modules/split-timing/Kconfig
```kconfig
config ZMK_SPLIT_TIMING
	bool "Process key presses of both halves in the order they were pressed"
	default y
	depends on ZMK_SPLIT
	help
	  The peripheral's key presses reach the central over Bluetooth a few
	  ms to ~20 ms late, so a central key pressed just after a peripheral
	  key overtook it. With this option the peripheral also sends the time
	  of every key event (its own GATT characteristic, next to ZMK's split
	  service). The central converts it to its own clock and processes all
	  key events, from both halves, in press order, each
	  ZMK_SPLIT_TIMING_DELAY_MS after it was pressed.

	  Both halves need it: a central without a timestamped peripheral
	  falls back to arrival order (plus the delay). Without Bluetooth the
	  split transport (zmk-modules/split-radio) provides the press times.

config ZMK_SPLIT_TIMING_DELAY_MS
	int "Delay from a key press to processing it (the longest split latency to wait for)"
	default 1 if ZMK_SPLIT_RADIO
	default 20
	depends on ZMK_SPLIT_TIMING

config ZMK_SPLIT_TIMING_HEARTBEAT_US
	int "Peripheral: send a heartbeat timestamp this often (us, 0 = off)"
	default 0
	depends on ZMK_SPLIT_TIMING && ZMK_SPLIT_BLE
	help
	  "Nothing pressed here before T": lets the central release its own
	  keys as soon as the link has caught up instead of after the full
	  delay. One small notification per period (use the link interval).

config ZMK_SPLIT_TIMING_WATERMARK
	bool "Central: release keys early once the peripheral's messages are newer"
	depends on ZMK_SPLIT_TIMING
	help
	  Bluetooth only, together with ZMK_SPLIT_TIMING_HEARTBEAT_US: tested
	  that way (docs/split-latency-research.md).

config ZMK_SPLIT_TIMING_WATERMARK_MARGIN_US
	int "Central: how much newer than a key the peripheral's message must be (us)"
	default 1000
	depends on ZMK_SPLIT_TIMING_WATERMARK

config ZMK_SPLIT_TIMING_LINK_MIN_US
	int "Fastest split link latency (us), subtracted from the peripheral's press times"
	default 2000
	depends on ZMK_SPLIT_TIMING
	help
	  The clock offset is learned from the fastest peripheral events, so
	  without this the peripheral's keys would be placed this much too
	  late. Measured on the Advantage 360 Pro: ~2.5 ms
	  (tests/e2e/test_split_timing.py).

# ---- split link tuning (central half), for experiments -----------------------

config ZMK_SPLIT_LINK_2M_PHY
	bool "Switch the split link to the 2M PHY"
	depends on ZMK_SPLIT_ROLE_CENTRAL && ZMK_SPLIT_BLE

config ZMK_SPLIT_LINK_NO_ADV_ON_USB
	bool "Don't advertise to Bluetooth hosts while typing over USB"
	depends on ZMK_SPLIT_ROLE_CENTRAL && ZMK_SPLIT_BLE && ZMK_USB
	help
	  Host advertising competes with the split link for the radio: without
	  it the split latency tail drops from ~17 ms to one connection
	  interval. While the selected output is USB the central doesn't
	  advertise (checked every 250 ms); switching the output to Bluetooth
	  (or unplugging) starts advertising again, a bonded host reconnects
	  within about a second.

config ZMK_SPLIT_LINK_NO_ADVERTISING
	bool "EXPERIMENT: keep the central from advertising to hosts (USB only)"
	depends on ZMK_SPLIT_ROLE_CENTRAL && ZMK_SPLIT_BLE
	help
	  Stops host advertising every 200 ms (it competes with the split link
	  for the radio). Bluetooth hosts can't connect.
```

## zmk-modules/usb-bootloader-reset/Kconfig
```kconfig
config ZMK_USB_BOOTLOADER_RESET
	bool "Reboot into the UF2 bootloader on a USB CDC ACM baud-rate 'touch'"
	depends on USB_CDC_ACM
	select CDC_ACM_DTE_RATE_CALLBACK_SUPPORT
	help
	  Registers a DTE rate callback on every zephyr,cdc-acm-uart instance.
	  When the host sets the magic baud rate (1200 by default, the classic
	  Arduino/Adafruit "1200 baud touch"), the device writes the UF2
	  bootloader magic into GPREGRET and reboots, exactly like the
	  &bootloader behavior does.

if ZMK_USB_BOOTLOADER_RESET

config ZMK_USB_BOOTLOADER_RESET_BAUD
	int "Magic baud rate that triggers the reboot"
	default 1200

config ZMK_USB_BOOTLOADER_RESET_DELAY_MS
	int "Delay before rebooting, lets the USB control transfer finish"
	default 100

endif

config ZMK_WATCHDOG
	bool "Reset the half if its firmware hangs (hardware watchdog)"
	default y
	depends on WATCHDOG
	help
	  The nRF watchdog resets the chip unless the system work queue (where
	  ZMK handles keys) feeds it: a hung half restarts within
	  ZMK_WATCHDOG_TIMEOUT_MS and its USB serial port comes back, so the
	  1200 baud bootloader reset keeps working without the reset button.
	  The reset reason is kept for the key monitor ("reset=" in its hello).

config ZMK_WATCHDOG_TIMEOUT_MS
	int "Watchdog timeout"
	default 4000
	depends on ZMK_WATCHDOG
```
